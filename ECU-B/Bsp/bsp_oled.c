/*
 * 文件名称：bsp_oled.c
 * 模块作用：维护SSD1306的1024字节RAM显存，并通过软件I2C刷新到OLED。
 * 刷新策略：命令使用短事务，整帧显存使用一次连续数据事务，避免逐字节START/STOP。
 */
#include "bsp_oled.h"
#include "bsp_i2c.h"

#define OLED_ADDR   0x3C
uint8_t OLED_Buffer[128 * 8];  // 1024字节显存

static void OLED_WriteCmd(uint8_t cmd)
{
    uint8_t buf[2] = {0x00, cmd};
    I2C1_WriteBuffer(OLED_ADDR, buf, 2);
}

/*
 * 连续发送整段OLED显存。
 * 0x40是SSD1306数据控制字节，后面的1024字节会连续写入显存。
 */
static void OLED_WriteDataBuffer(const uint8_t *buffer, uint16_t length)
{
    uint16_t i;

    if ((buffer == 0) || (length == 0U))
    {
        return;
    }

    I2C1_Start();
    I2C1_SendAddr(OLED_ADDR, 0U);

    I2C1_SendData(0x40U);
    (void)I2C1_WaitAck();

    for (i = 0U; i < length; i++)
    {
        I2C1_SendData(buffer[i]);
        (void)I2C1_WaitAck();
    }

    I2C1_Stop();
}

void OLED_Init(void)
{
    OLED_WriteCmd(0xAE); OLED_WriteCmd(0xD5); OLED_WriteCmd(0x80);
    OLED_WriteCmd(0xA8); OLED_WriteCmd(0x3F); OLED_WriteCmd(0xD3);
    OLED_WriteCmd(0x00); OLED_WriteCmd(0x40); OLED_WriteCmd(0x8D);
    OLED_WriteCmd(0x14); OLED_WriteCmd(0x20); OLED_WriteCmd(0x00);
    OLED_WriteCmd(0xA1); OLED_WriteCmd(0xC8); OLED_WriteCmd(0xDA);
    OLED_WriteCmd(0x12); OLED_WriteCmd(0x81); OLED_WriteCmd(0x7F);
    OLED_WriteCmd(0xD9); OLED_WriteCmd(0xF1); OLED_WriteCmd(0xDB);
    OLED_WriteCmd(0x40); OLED_WriteCmd(0xA4); OLED_WriteCmd(0xA6);
    OLED_WriteCmd(0x2E); OLED_WriteCmd(0xAF);
    OLED_Clear();
}

void OLED_Clear(void)
{
    for(uint16_t i = 0; i < sizeof(OLED_Buffer); i++) OLED_Buffer[i] = 0x00;
    //OLED_Refresh();
}




void OLED_Refresh(void)
{
    OLED_WriteCmd(0x21); OLED_WriteCmd(0x00); OLED_WriteCmd(0x7F);
    OLED_WriteCmd(0x22); OLED_WriteCmd(0x00); OLED_WriteCmd(0x07);

    OLED_WriteDataBuffer(OLED_Buffer, (uint16_t)sizeof(OLED_Buffer));
}

void OLED_DrawPixel(uint8_t x, uint8_t y, uint8_t color)
{
    if(x >= 128 || y >= 64) return;
    if(color)
        OLED_Buffer[x + (y / 8) * 128] |= (1 << (y % 8));
    else
        OLED_Buffer[x + (y / 8) * 128] &= ~(1 << (y % 8));
}

// 6x8 ASCII字库（空格~ ~，95个字符）
// 每个字符6字节，每字节表示一列的8个像素点
static const uint8_t g_font_6x8[][6] = {
    {0x00,0x00,0x00,0x00,0x00,0x00}, //
    {0x00,0x00,0x5F,0x00,0x00,0x00}, // !
    {0x00,0x07,0x00,0x07,0x00,0x00}, // "
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    {0x44,0x64,0x54,0x4C,0x44,0x00}, // z
};

void OLED_ShowChar(uint8_t x, uint8_t y, char ch)
{
    if(((uint8_t)ch < 32U) || ((uint8_t)ch > 127U)) ch = 32;
    uint8_t idx = ch - 32;
    for(uint8_t i = 0; i < 6; i++)
    {
        uint8_t line = g_font_6x8[idx][i];
        for(uint8_t j = 0; j < 8; j++)
        {
            if(line & (1 << j))
                OLED_DrawPixel(x + i, y + j, 1);
            else
                OLED_DrawPixel(x + i, y + j, 0);
        }
    }
}

void OLED_ShowString(uint8_t x, uint8_t row, const char *str)
{
    while(*str)
    {
        OLED_ShowChar(
            x,
            row * 8,
            *str);

        str++;

        x += 6;

        if(x > 122)
        {
            x = 0;
            row++;

            if(row >= 8)
                break;
        }
    }
}
